## main/Kconfig.projbuild
```kconfig
menu "Wireless AP Configuration"

config WIFI_SSID
    string "WiFi SSID"
    default "myssid"
    help
        SSID (network name) for the example to connect to.

config WIFI_PASSWORD
    string "WiFi Password"
    default "mypassword"
    help
        WiFi password (WPA or WPA2) for the example to use.

endmenu

menu "Psmoveapi Moved Daemon"
config MOVED_PORT
    int "UDP listen port"
    default 17777
    help
	UDP port to bind and listen to moved_client requests
	
config BUTTON_TRIGGER_GPIO
    int "Trigger Button GPIO"
    default 2
    help
	GPIO pin used to determine trigger state
	
config BUTTON_NORMALLY_OPEN
    bool "Normally Open"
    default true
    help
        Sets the type of switch used on the trigger GPIO pin

menu "Main LED GPIO Pin-mapping"
config GPIO_R
    int "Red GPIO pin"
    default 15
    range 0 33
    help
	GPIO pin to use for the main RED led
	
config GPIO_G
    int "Green GPIO pin"
    default 16
    range 0 33
    help
	GPIO pin to use for the main RED led
	
config GPIO_B
    int "Blue GPIO pin"
    default 17
    range 0 33
    help
	GPIO pin to use for the main RED led
    
endmenu
menu "I2C Assignments"
config I2C_MASTER_SCL_PIN
    int "SCL pin"
    default 19
    help
	I2C Clock GPIO pin
config I2C_MASTER_SDA_PIN
    int "SDA pin"
    default 18
    help
	I2C Clock GPIO pin
config I2C_MASTER_PORT
    int "I2C port"
    range 0 2
    default 1
    help
	Hardware port on the esp32
config I2C_MASTER_PULLUP
    bool "Enable Pullup"
    default y

endmenu

menu "Accelerometer"
config I2C_ACCEL_ADR
    int "7 Bit Addr"
    default 0x68
    help
	I2C Address of Accelerometer (7bit)
endmenu

endmenu
```
